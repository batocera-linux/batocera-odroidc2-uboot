## configs/batocera-odroidc2-boot_defconfig
```kconfig
BR2_aarch64=y
BR2_OPTIMIZE_3=y
# BR2_UCLIBC_INSTALL_UTILS is not set
BR2_GCC_VERSION_4_9_X=y
# BR2_TARGET_ROOTFS_TAR is not set
BR2_TARGET_UBOOT=y
BR2_TARGET_UBOOT_BOARDNAME="odroidc2"
BR2_TARGET_UBOOT_CUSTOM_GIT=y
BR2_TARGET_UBOOT_CUSTOM_REPO_URL="https://github.com/hardkernel/u-boot.git"
BR2_TARGET_UBOOT_CUSTOM_REPO_VERSION="odroidc2-v2015.01"
BR2_PACKAGE_RECALBOX_TARGET_C2=y
```
